// Copyright (c) 2025 The ZMK Contributors
// SPDX-License-Identifier: MIT

#include "drift.dtsi"

// Enable left encoder device (for volume, scrolling, etc.)
&left_encoder {
	status = "okay";
};

 / {
	chosen {
		// Define the default key scanning matrix
		zmk,kscan = &kscan0;
	};

	// Keyboard matrix definition
	kscan0: kscan {
		compatible = "zmk,kscan-gpio-matrix";		
		diode-direction = "col2row";       // Current flows from column → row
		wakeup-source;                     // Allow wake from sleep on key press

		// Column pins (C0–C6)
		col-gpios = <&pro_micro 5 GPIO_ACTIVE_HIGH>
		           ,<&pro_micro 6 GPIO_ACTIVE_HIGH>
		           ,<&pro_micro 7 GPIO_ACTIVE_HIGH>
		           ,<&pro_micro 8 GPIO_ACTIVE_HIGH>
		           ,<&pro_micro 9 GPIO_ACTIVE_HIGH>
		           ,<&pro_micro 10 GPIO_ACTIVE_HIGH>
		           ,<&pro_micro 16 GPIO_ACTIVE_HIGH>;

		// Row pins (R0–R4) with pull-downs
		row-gpios = <&pro_micro 20 (GPIO_ACTIVE_HIGH|GPIO_PULL_DOWN)>
		           ,<&pro_micro 19 (GPIO_ACTIVE_HIGH|GPIO_PULL_DOWN)>
		           ,<&pro_micro 18 (GPIO_ACTIVE_HIGH|GPIO_PULL_DOWN)>
		           ,<&pro_micro 15 (GPIO_ACTIVE_HIGH|GPIO_PULL_DOWN)>
		           ,<&pro_micro 14 (GPIO_ACTIVE_HIGH|GPIO_PULL_DOWN)>;
	};
};