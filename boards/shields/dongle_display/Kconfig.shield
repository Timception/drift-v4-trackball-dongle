## boards/shields/dongle_display/Kconfig.shield
```kconfig
# Copyright (c) 2025 The ZMK Contributors
# SPDX-License-Identifier: MIT

config SHIELD_DONGLE_DISPLAY
	def_bool $(shields_list_contains,dongle_display)
```

## boards/shields/drift/Kconfig.shield
```kconfig
config SHIELD_DRIFT_LEFT
    def_bool $(shields_list_contains,drift_left)

config SHIELD_DRIFT_RIGHT
    def_bool $(shields_list_contains,drift_right)

config SHIELD_DRIFT_DONGLE
	def_bool $(shields_list_contains,drift_dongle)
```
